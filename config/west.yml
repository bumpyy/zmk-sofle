## config/west.yml
```yaml
manifest:
  remotes:
    - name: zmkfirmware
      url-base: https://github.com/zmkfirmware
    # - name: englmaxi
    #   url-base: https://github.com/englmaxi
    #  nice gem
    # - name: m165437
    #   url-base: https://github.com/M165437
    # support nice_oled and nice_epaper
    # - name: mctechnology17
    #   url-base: https://github.com/mctechnology17
  projects:
    - name: zmk
      remote: zmkfirmware
      revision: v0.3
      import: app/west.yml
    # - name: zmk-dongle-display
    #   remote: englmaxi
    #   revision: v0.3
    # - name: nice-view-gem
    #   remote: m165437
    #   revision: main
    # support nice_oled and nice_epaper
    # - name: zmk-nice-oled
    #   remote: mctechnology17
    #   revision: main
  self:
    path: config
```
